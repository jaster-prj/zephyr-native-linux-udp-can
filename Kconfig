## Kconfig
```kconfig
# SPDX-License-Identifier: Apache-2.0

menu "External native-linux-udp-can module"

source "drivers/can/Kconfig.native_udp"

endmenu
```

## drivers/can/Kconfig.native_udp
```kconfig
# Native UDP CAN gateway configuration options
# SPDX-License-Identifier: Apache-2.0

config CAN_NATIVE_UDP
	bool "Native Linux UDP CAN gateway driver"
	default n
	depends on ARCH_POSIX
	help
	  Enable a Linux host-side CAN driver that transports CAN frames over UDP.
	  This is intended for native_sim and other host-side environments where a
	  UDP gateway bridges CAN traffic to vcan or a physical CAN controller.

if CAN_NATIVE_UDP

config CAN_NATIVE_UDP_RX_THREAD_PRIORITY
	int "Priority for internal RX thread"
	default 2
	help
	  Priority level of the internal thread which is run for handling incoming
	  UDP packets.

config CAN_NATIVE_UDP_MAX_FILTERS
	int "Maximum number of concurrent active filters"
	default 16
	range 1 32
	help
	  Defines the array size of the callback/msgq pointers.
	  Must be at least the size of concurrent reads.

endif # CAN_NATIVE_UDP
```

## dts/bindings/can/zephyr,native-linux-udp-can.yaml
```yaml
# Copyright (c) 2026
# SPDX-License-Identifier: Apache-2.0

description: Zephyr CAN driver using a UDP gateway

compatible: "zephyr,native-linux-udp-can"

include: can-fd-controller.yaml

properties:
  host:
    type: string
    required: true
    description: |
      Hostname or IPv4 address of the UDP CAN gateway.

  port:
    type: int
    required: true
    description: |
      UDP port used by the gateway.

  local-port:
    type: int
    required: false
    default: 0
    description: |
      Local UDP port to bind for receiving traffic. 0 selects an ephemeral port.
```
